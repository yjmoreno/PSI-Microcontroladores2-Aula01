## .pio/build/frdm_kl25z/Kconfig/arch/Kconfig
```kconfig
# Load Zephyr Arch Kconfig descriptions.
osource "/Users/yjrodrigues/.platformio/packages/framework-zephyr/arch/rx/Kconfig"
osource "/Users/yjrodrigues/.platformio/packages/framework-zephyr/arch/x86/Kconfig"
osource "/Users/yjrodrigues/.platformio/packages/framework-zephyr/arch/xtensa/Kconfig"
osource "/Users/yjrodrigues/.platformio/packages/framework-zephyr/arch/sparc/Kconfig"
osource "/Users/yjrodrigues/.platformio/packages/framework-zephyr/arch/riscv/Kconfig"
osource "/Users/yjrodrigues/.platformio/packages/framework-zephyr/arch/posix/Kconfig"
osource "/Users/yjrodrigues/.platformio/packages/framework-zephyr/arch/mips/Kconfig"
osource "/Users/yjrodrigues/.platformio/packages/framework-zephyr/arch/arm64/Kconfig"
osource "/Users/yjrodrigues/.platformio/packages/framework-zephyr/arch/arm/Kconfig"
osource "/Users/yjrodrigues/.platformio/packages/framework-zephyr/arch/arc/Kconfig"
```

## .pio/build/frdm_kl25z/Kconfig/boards/Kconfig.defconfig
```kconfig
# Load Zephyr board defconfig descriptions.
osource "/Users/yjrodrigues/.platformio/packages/framework-zephyr/boards/nxp/frdm_kl25z/Kconfig.defconfig"
```

## .pio/build/frdm_kl25z/Kconfig/boards/Kconfig.sysbuild
```kconfig
# Load Sysbuild board Kconfig descriptions.
osource "/Users/yjrodrigues/.platformio/packages/framework-zephyr/boards/nxp/frdm_kl25z/Kconfig.sysbuild"
```

## .pio/build/frdm_kl25z/Kconfig/soc/Kconfig
```kconfig
# Load Zephyr SoC Kconfig descriptions.
osource "/Users/yjrodrigues/.platformio/packages/framework-zephyr/soc/xlnx/zynqmp/Kconfig"
osource "/Users/yjrodrigues/.platformio/packages/framework-zephyr/soc/xlnx/zynq7000/Kconfig"
osource "/Users/yjrodrigues/.platformio/packages/framework-zephyr/soc/xlnx/versalnet/Kconfig"
osource "/Users/yjrodrigues/.platformio/packages/framework-zephyr/soc/xlnx/versal2/Kconfig"
osource "/Users/yjrodrigues/.platformio/packages/framework-zephyr/soc/xen/Kconfig"
osource "/Users/yjrodrigues/.platformio/packages/framework-zephyr/soc/wch/ch32v/Kconfig"
osource "/Users/yjrodrigues/.platformio/packages/framework-zephyr/soc/ti/simplelink/Kconfig"
osource "/Users/yjrodrigues/.platformio/packages/framework-zephyr/soc/ti/mspm0/Kconfig"
osource "/Users/yjrodrigues/.platformio/packages/framework-zephyr/soc/ti/lm3s6965/Kconfig"
osource "/Users/yjrodrigues/.platformio/packages/framework-zephyr/soc/ti/k3/Kconfig"
osource "/Users/yjrodrigues/.platformio/packages/framework-zephyr/soc/telink/tlsr/Kconfig"
osource "/Users/yjrodrigues/.platformio/packages/framework-zephyr/soc/starfive/jh71xx/Kconfig"
osource "/Users/yjrodrigues/.platformio/packages/framework-zephyr/soc/st/stm32/Kconfig"
osource "/Users/yjrodrigues/.platformio/packages/framework-zephyr/soc/snps/qemu_arc/Kconfig"
osource "/Users/yjrodrigues/.platformio/packages/framework-zephyr/soc/snps/nsim/arc_v/Kconfig"
osource "/Users/yjrodrigues/.platformio/packages/framework-zephyr/soc/snps/nsim/arc_classic/Kconfig"
osource "/Users/yjrodrigues/.platformio/packages/framework-zephyr/soc/snps/hsdk4xd/Kconfig"
osource "/Users/yjrodrigues/.platformio/packages/framework-zephyr/soc/snps/hsdk/Kconfig"
osource "/Users/yjrodrigues/.platformio/packages/framework-zephyr/soc/snps/emsk/Kconfig"
osource "/Users/yjrodrigues/.platformio/packages/framework-zephyr/soc/snps/emsdp/Kconfig"
osource "/Users/yjrodrigues/.platformio/packages/framework-zephyr/soc/snps/arc_iot/Kconfig"
osource "/Users/yjrodrigues/.platformio/packages/framework-zephyr/soc/silabs/Kconfig"
osource "/Users/yjrodrigues/.platformio/packages/framework-zephyr/soc/sifive/sifive_freedom/Kconfig"
osource "/Users/yjrodrigues/.platformio/packages/framework-zephyr/soc/sensry/Kconfig"
osource "/Users/yjrodrigues/.platformio/packages/framework-zephyr/soc/rockchip/Kconfig"
osource "/Users/yjrodrigues/.platformio/packages/framework-zephyr/soc/renode/riscv_virtual/Kconfig"
osource "/Users/yjrodrigues/.platformio/packages/framework-zephyr/soc/renode/cortex_r8_virtual/Kconfig"
osource "/Users/yjrodrigues/.platformio/packages/framework-zephyr/soc/renesas/smartbond/Kconfig"
osource "/Users/yjrodrigues/.platformio/packages/framework-zephyr/soc/renesas/rz/Kconfig"
osource "/Users/yjrodrigues/.platformio/packages/framework-zephyr/soc/renesas/rx/Kconfig"
osource "/Users/yjrodrigues/.platformio/packages/framework-zephyr/soc/renesas/rcar/Kconfig"
osource "/Users/yjrodrigues/.platformio/packages/framework-zephyr/soc/renesas/ra/Kconfig"
osource "/Users/yjrodrigues/.platformio/packages/framework-zephyr/soc/realtek/ec/Kconfig"
osource "/Users/yjrodrigues/.platformio/packages/framework-zephyr/soc/raspberrypi/rpi_pico/Kconfig"
osource "/Users/yjrodrigues/.platformio/packages/framework-zephyr/soc/quicklogic/eos_s3/Kconfig"
osource "/Users/yjrodrigues/.platformio/packages/framework-zephyr/soc/qemu/virt_riscv/Kconfig"
osource "/Users/yjrodrigues/.platformio/packages/framework-zephyr/soc/qemu/malta/Kconfig"
osource "/Users/yjrodrigues/.platformio/packages/framework-zephyr/soc/openisa/rv32m1/Kconfig"
osource "/Users/yjrodrigues/.platformio/packages/framework-zephyr/soc/openhwgroup/cva6/Kconfig"
osource "/Users/yjrodrigues/.platformio/packages/framework-zephyr/soc/oct/osd32mp15x/Kconfig"
osource "/Users/yjrodrigues/.platformio/packages/framework-zephyr/soc/nxp/s32/Kconfig"
osource "/Users/yjrodrigues/.platformio/packages/framework-zephyr/soc/nxp/rw/Kconfig"
osource "/Users/yjrodrigues/.platformio/packages/framework-zephyr/soc/nxp/mcx/Kconfig"
osource "/Users/yjrodrigues/.platformio/packages/framework-zephyr/soc/nxp/lpc/Kconfig"
osource "/Users/yjrodrigues/.platformio/packages/framework-zephyr/soc/nxp/layerscape/Kconfig"
osource "/Users/yjrodrigues/.platformio/packages/framework-zephyr/soc/nxp/kinetis/Kconfig"
osource "/Users/yjrodrigues/.platformio/packages/framework-zephyr/soc/nxp/imxrt/Kconfig"
osource "/Users/yjrodrigues/.platformio/packages/framework-zephyr/soc/nxp/imx/Kconfig"
osource "/Users/yjrodrigues/.platformio/packages/framework-zephyr/soc/nuvoton/numicro/Kconfig"
osource "/Users/yjrodrigues/.platformio/packages/framework-zephyr/soc/nuvoton/numaker/Kconfig"
osource "/Users/yjrodrigues/.platformio/packages/framework-zephyr/soc/nuvoton/npcx/Kconfig"
osource "/Users/yjrodrigues/.platformio/packages/framework-zephyr/soc/nuvoton/npcm/Kconfig"
osource "/Users/yjrodrigues/.platformio/packages/framework-zephyr/soc/nordic/Kconfig"
osource "/Users/yjrodrigues/.platformio/packages/framework-zephyr/soc/neorv32/Kconfig"
osource "/Users/yjrodrigues/.platformio/packages/framework-zephyr/soc/native/inf_clock/Kconfig"
osource "/Users/yjrodrigues/.platformio/packages/framework-zephyr/soc/microchip/sam/Kconfig"
osource "/Users/yjrodrigues/.platformio/packages/framework-zephyr/soc/microchip/miv/Kconfig"
osource "/Users/yjrodrigues/.platformio/packages/framework-zephyr/soc/microchip/mec/Kconfig"
osource "/Users/yjrodrigues/.platformio/packages/framework-zephyr/soc/mediatek/mt8xxx/Kconfig"
osource "/Users/yjrodrigues/.platformio/packages/framework-zephyr/soc/lowrisc/opentitan/Kconfig"
osource "/Users/yjrodrigues/.platformio/packages/framework-zephyr/soc/litex/litex_vexriscv/Kconfig"
osource "/Users/yjrodrigues/.platformio/packages/framework-zephyr/soc/ite/ec/Kconfig"
osource "/Users/yjrodrigues/.platformio/packages/framework-zephyr/soc/intel/raptor_lake/Kconfig"
osource "/Users/yjrodrigues/.platformio/packages/framework-zephyr/soc/intel/lakemont/Kconfig"
osource "/Users/yjrodrigues/.platformio/packages/framework-zephyr/soc/intel/intel_socfpga_std/Kconfig"
osource "/Users/yjrodrigues/.platformio/packages/framework-zephyr/soc/intel/intel_socfpga/Kconfig"
osource "/Users/yjrodrigues/.platformio/packages/framework-zephyr/soc/intel/intel_niosv/Kconfig"
osource "/Users/yjrodrigues/.platformio/packages/framework-zephyr/soc/intel/intel_ish/Kconfig"
osource "/Users/yjrodrigues/.platformio/packages/framework-zephyr/soc/intel/intel_adsp/Kconfig"
osource "/Users/yjrodrigues/.platformio/packages/framework-zephyr/soc/intel/elkhart_lake/Kconfig"
osource "/Users/yjrodrigues/.platformio/packages/framework-zephyr/soc/intel/atom/Kconfig"
osource "/Users/yjrodrigues/.platformio/packages/framework-zephyr/soc/intel/apollo_lake/Kconfig"
osource "/Users/yjrodrigues/.platformio/packages/framework-zephyr/soc/intel/alder_lake/Kconfig"
osource "/Users/yjrodrigues/.platformio/packages/framework-zephyr/soc/infineon/cat3/Kconfig"
osource "/Users/yjrodrigues/.platformio/packages/framework-zephyr/soc/infineon/cat1c/Kconfig"
osource "/Users/yjrodrigues/.platformio/packages/framework-zephyr/soc/infineon/cat1b/Kconfig"
osource "/Users/yjrodrigues/.platformio/packages/framework-zephyr/soc/infineon/cat1a/Kconfig"
osource "/Users/yjrodrigues/.platformio/packages/framework-zephyr/soc/gd/gd32/Kconfig"
osource "/Users/yjrodrigues/.platformio/packages/framework-zephyr/soc/gaisler/leon3/Kconfig"
osource "/Users/yjrodrigues/.platformio/packages/framework-zephyr/soc/gaisler/gr716a/Kconfig"
osource "/Users/yjrodrigues/.platformio/packages/framework-zephyr/soc/espressif/Kconfig"
osource "/Users/yjrodrigues/.platformio/packages/framework-zephyr/soc/ene/kb1200/Kconfig"
osource "/Users/yjrodrigues/.platformio/packages/framework-zephyr/soc/ene/kb106x/Kconfig"
osource "/Users/yjrodrigues/.platformio/packages/framework-zephyr/soc/efinix/sapphire/Kconfig"
osource "/Users/yjrodrigues/.platformio/packages/framework-zephyr/soc/cdns/xtensa_sample_controller/Kconfig"
osource "/Users/yjrodrigues/.platformio/packages/framework-zephyr/soc/cdns/sample_controller32/Kconfig"
osource "/Users/yjrodrigues/.platformio/packages/framework-zephyr/soc/cdns/dc233c/Kconfig"
osource "/Users/yjrodrigues/.platformio/packages/framework-zephyr/soc/brcm/bcmvk/Kconfig"
osource "/Users/yjrodrigues/.platformio/packages/framework-zephyr/soc/brcm/bcm2712/Kconfig"
osource "/Users/yjrodrigues/.platformio/packages/framework-zephyr/soc/brcm/bcm2711/Kconfig"
osource "/Users/yjrodrigues/.platformio/packages/framework-zephyr/soc/bflb/Kconfig"
osource "/Users/yjrodrigues/.platformio/packages/framework-zephyr/soc/atmel/sam0/Kconfig"
osource "/Users/yjrodrigues/.platformio/packages/framework-zephyr/soc/atmel/sam/Kconfig"
osource "/Users/yjrodrigues/.platformio/packages/framework-zephyr/soc/aspeed/Kconfig"
osource "/Users/yjrodrigues/.platformio/packages/framework-zephyr/soc/arm/Kconfig"
osource "/Users/yjrodrigues/.platformio/packages/framework-zephyr/soc/arm/beetle/Kconfig"
osource "/Users/yjrodrigues/.platformio/packages/framework-zephyr/soc/antmicro/myra/Kconfig"
osource "/Users/yjrodrigues/.platformio/packages/framework-zephyr/soc/andestech/Kconfig"
osource "/Users/yjrodrigues/.platformio/packages/framework-zephyr/soc/amd/acp_6_0/Kconfig"
osource "/Users/yjrodrigues/.platformio/packages/framework-zephyr/soc/ambiq/Kconfig"
osource "/Users/yjrodrigues/.platformio/packages/framework-zephyr/soc/aesc/Kconfig"
osource "/Users/yjrodrigues/.platformio/packages/framework-zephyr/soc/adi/max32/Kconfig"
```
